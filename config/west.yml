## config/west.yml
```yaml
manifest:
  remotes:
    - name: zmkfirmware
      url-base: https://github.com/ziteh
  projects:
    - name: zmk
      remote: zmkfirmware
      revision: siderakb/ergosnm-shield
      import: app/west.yml
  self:
    path: config
```
